/*
  All-in-one setPWM
  This example shows how to configure a PWM with HardwareTimer in one single function call.
  PWM is generated on `LED_BUILTIN` if available.
  No interruption callback used: PWM is generated by hardware.
  Once configured, there is no CPU load.
*/

/*
  Note: Please verify that 'pin' used for PWM has HardwareTimer capability for your board
  This is specially true for F1 serie (BluePill, ...)
*/

/*
#if defined(LED_BUILTIN)
#define pin  LED_BUILTIN
#else
#define pin  D2
#endif
*/
#define pin PC13    // LED pin

unsigned long count = 1990;
HardwareTimer *MyTim = NULL;
void setup()
{
  // no need to configure pin, it will be done by HardwareTimer configuration
  // pinMode(pin, OUTPUT);

  // Automatically retrieve TIM instance and channel associated to pin
  // This is used to be compatible with all STM32 series automatically.
  TIM_TypeDef *Instance = (TIM_TypeDef *)pinmap_peripheral(digitalPinToPinName(pin), PinMap_PWM);
  uint32_t channel = STM_PIN_CHANNEL(pinmap_function(digitalPinToPinName(pin), PinMap_PWM));

 // Initialize serial and wait for port to be opened:
  Serial.begin(115200);
  while (!Serial)
    delay(1);               // wait for native USB serial port to connect
  Serial.write("Blue Pill: All-in-one_setPWM pin ");
  Serial.print(pin);  Serial.write(", channel "); Serial.print(channel);
  
  // Instantiate HardwareTimer object. Thanks to 'new' instantiation, HardwareTimer is not destructed when setup() function is finished.
//  MyTim = new HardwareTimer(Instance);

  // Configure and start PWM
  // MyTim->setPWM(channel, pin, 5, 10, NULL, NULL); // No callback required, we can simplify the function call
//  MyTim->setPWM(channel, pin, 5, 10); // 5 Hertz, 10% dutycycle;   throws an exception if not set
}


void loop()
{
  /* Nothing to do all is done by hardware. Even no interrupt required. */
 if (MyTim)
   MyTim->pause();
 count++;
 if (0 < Serial.available()) {
    byte received = Serial.read(); 
    Serial.write("Ignoring ");   Serial.println(received);
    count = 0;
 }
 else if (2000000 < count) {
    Serial.write("Nothing received...\n");
    count = 0;
 }
 if (MyTim)
   MyTim->resume();
}
